## src/drivers/fpga_i2c_pwm_out/Kconfig
```kconfig
menuconfig DRIVERS_FPGA_I2C_PWM_OUT
	bool "fpga_i2c_pwm_out"
	default n
	---help---
		Enable support for fpga_i2c_pwm_out
```

## src/drivers/fpga_spi_pwm_out/Kconfig
```kconfig
menuconfig DRIVERS_FPGA_I2C_PWM_OUT
	bool "fpga_i2c_pwm_out"
	default n
	---help---
		Enable support for fpga_i2c_pwm_out

menuconfig DRIVERS_FPGA_SPI_PWM_OUT
	bool "fpga_spi_pwm_out"
	default n
	---help---
		Enable support for fpga_spi_pwm_out
```
