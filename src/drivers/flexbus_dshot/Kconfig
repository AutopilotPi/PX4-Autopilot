## src/drivers/flexbus_dshot/Kconfig
```kconfig
menuconfig DRIVERS_FLEXBUS_DSHOT
	bool "Rockchip Flexbus DShot"
	default n
	---help---
		Enable DShot output through the Rockchip flexbus DShot kernel driver.
```

## src/drivers/imu/silan/sc7u22/Kconfig
```kconfig
menuconfig DRIVERS_IMU_SILAN_SC7U22
	bool "silan sc7u22"
	default n
	---help---
		Enable support for Silan SC7U22.
```

## src/drivers/imu/silan/sc7u22_iio/Kconfig
```kconfig
menuconfig DRIVERS_IMU_SILAN_SC7U22_IIO
	bool "Silan SC7U22 Linux IIO"
	default n
	depends on PLATFORM_POSIX
	---help---
		Enable the PX4 userspace adapter for the Linux SC7U22 IIO driver.
```

## src/drivers/rp_fcc/Kconfig
```kconfig
menuconfig DRIVERS_RP_FCC
	bool "RP_FCC"
	default n
	---help---
		Enable support for dshot by using rp2040
```
